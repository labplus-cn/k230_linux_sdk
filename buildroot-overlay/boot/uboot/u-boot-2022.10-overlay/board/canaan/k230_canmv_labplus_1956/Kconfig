## buildroot-overlay/boot/uboot/u-boot-2022.10-overlay/board/canaan/k230_canmv_labplus_1956/Kconfig
```kconfig
if TARGET_K230_CANMV_LABPLUS_1956

config SYS_CPU
	default "k230"

config SYS_VENDOR
    default "canaan"

config SYS_BOARD
    default "k230_canmv_labplus_1956"

config SYS_CONFIG_NAME
    default "k230_evb"


config BOARD_SPECIFIC_OPTIONS # dummy
	def_bool y
	select RISCV_THEAD
	choice
		prompt "ddr typy freq"
		default CANMV_LABPLUS_1956_LPDDR4_2667

	config CANMV_LABPLUS_1956_LPDDR4_2667
		bool LP4_2667
	config CANMV_LABPLUS_1956_LPDDR4_3200
		bool LP4_3200
	endchoice
endif
```
